## CMakeLists.txt
```
# SPDX-License-Identifier: Apache-2.0

cmake_minimum_required(VERSION 3.20.0)

find_package(Zephyr REQUIRED HINTS $ENV{ZEPHYR_BASE})
project(hello_world)


target_include_directories(app PRIVATE inc)
add_subdirectory(src)
```

## prj.conf
```kconfig
CONFIG_CPP=y
CONFIG_COMMON_LIBC_MALLOC_ARENA_SIZE=2048
CONFIG_NEWLIB_LIBC=y
CONFIG_MAIN_STACK_SIZE=2048
```

## src/main.cpp
```c
#include <ConfigService.hpp>
#include <MqttService.hpp>
#include <ModbusService.hpp>

int main()
{
    ConfigService *cfgService = ConfigService::Create();
    MqttService *mqttService = MqttService::Create(cfgService);
    ModbusService *modbusService = ModbusService::Create(cfgService);

    cfgService->Start();
    mqttService->Start();
    modbusService->Start();

    return 0;
}
```

## inc/ConfigService.hpp
```c
#ifndef __CONFIG_SERVICE_H__
#define __CONFIG_SERVICE_H__

class ConfigService
{
public:
    static ConfigService *Create();
    int Start();
};

#endif
```

## inc/ModbusService.hpp
```c
#ifndef __MODBUS_SERVICE_H__
#define __MODBUS_SERVICE_H__

#include <ConfigService.hpp>

class ModbusService
{
public:
    static ModbusService *Create(ConfigService *cfgService);
    int Start();
};

#endif
```

## inc/MqttService.hpp
```c
#ifndef __MQTT_SERVICE_H__
#define __NQTT_SERVICE_H__

#include <ConfigService.hpp>

class MqttService
{
public:
    static MqttService *Create(ConfigService *cfgService);
    int Start();
};

#endif
```

## inc/interconnect.hpp
```c
#ifndef __INTERCONNECT_H__
#define __INTERCONNECT_H__

#include <zephyr/kernel.h>
#define CONFIG_MODBUS_MQTT_DATA 511
#define CONFIG_MAX_MODBUS_MQTT_MSGQ 2

// modbus <-> mqtt
struct Mobus2MqttData
{
    uint8_t unitID;
    uint8_t data[CONFIG_MODBUS_MQTT_DATA];
    unsigned data_len;
};


extern k_msgq modbus2mqtt_msgq;
extern k_msgq mqtt2modbus_msgq;



#endif
```

## src/interconnect.cpp
```c
#include <interconnect.hpp>

K_MSGQ_DEFINE(modbus2mqtt_msgq,
              sizeof(struct Mobus2MqttData),
              CONFIG_MAX_MODBUS_MQTT_MSGQ,
              8);

K_MSGQ_DEFINE(mqtt2modbus_msgq,
              sizeof(struct Mobus2MqttData),
              CONFIG_MAX_MODBUS_MQTT_MSGQ,
              8);
```
